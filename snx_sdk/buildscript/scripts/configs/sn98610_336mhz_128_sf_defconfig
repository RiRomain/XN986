## snx_sdk/kernel/linux-2.6.35.12/src/arch/arm/mach-sn986xx/Kconfig
```kconfig
# Create at 2011/05/06 by yanjie_yang

menu "SONiX SN986XX Implementations"

choice
	prompt "Select target board"
	default MACH_SN98600 

config MACH_SN98600
	bool "Support SONiX SN98600 Platform"
	help
	  Include support for the SONiX SN98600 platform.

config MACH_SN98601
	bool "Support SONiX SN98601 Platform"
	help
	  Include support for the SONiX SN98601 platform.

config MACH_SN98605
	bool "Support SONiX SN98605 Platform"
	help
	  Include support for the SONiX SN98605 platform.

config MACH_SN98610
	bool "Support SONiX SN98610 Platform"
	help
	  Include support for the SONiX SN98610 platform.

config MACH_SN98660
	bool "Support SONiX SN98660 Platform"
	help
	  Include support for the SONiX SN98660 platform.

endchoice

comment "Board configuration"

config PLL_CLK
	int "PLL clock frequency (PLL clock)"
	default 744000000
	help
	  Manual setting of PLL clock frequency. 

config TICK_CLOCK_RATIO
	int "Ratio of PLL/TICK clock frequency"
	default 32
	help
	  Manual setting of tick clock frequency ratio. 
	  Tick clock frequency should be equal to APB clock frequency.

config SPECIAL_HW_TIMER
	bool "Support special hardware timer"
	help
	  Include support for the special hardware timer.

config SNX_LOG_TIMESTAMP
	bool "Sonix log timestamp"
	help
	  Support log timestamp for traceing system performace or latency

	  How to use:
	  1. include linux/timex.h
	  2. Insert snx_log_timestamp(int tag) for log timestamp that tag number
	     up to you
	  3. Read /proc/snx_timestamp to trace system

endmenu
```

## snx_sdk/kernel/linux-2.6.35.12/src/drivers/net/arm/Kconfig
```kconfig
#
# Acorn Network device configuration
#  These are for Acorn's Expansion card network interfaces
#
config ARM_AM79C961A
	bool "ARM EBSA110 AM79C961A support"
	depends on ARM && ARCH_EBSA110
	select CRC32
	help
	  If you wish to compile a kernel for the EBSA-110, then you should
	  always answer Y to this.

config ARM_ETHER1
	tristate "Acorn Ether1 support"
	depends on ARM && ARCH_ACORN
	help
	  If you have an Acorn system with one of these (AKA25) network cards,
	  you should say Y to this option if you wish to use it with Linux.

config ARM_ETHER3
	tristate "Acorn/ANT Ether3 support"
	depends on ARM && ARCH_ACORN
	help
	  If you have an Acorn system with one of these network cards, you
	  should say Y to this option if you wish to use it with Linux.

config ARM_ETHERH
	tristate "I-cubed EtherH/ANT EtherM support"
	depends on ARM && ARCH_ACORN
	select CRC32
	help
	  If you have an Acorn system with one of these network cards, you
	  should say Y to this option if you wish to use it with Linux.

config ARM_AT91_ETHER
	tristate "AT91RM9200 Ethernet support"
	depends on ARM && ARCH_AT91RM9200
	select MII
	help
	  If you wish to compile a kernel for the AT91RM9200 and enable
	  ethernet support, then you should always answer Y to this.

config ARM_KS8695_ETHER
	tristate "KS8695 Ethernet support"
	depends on ARM && ARCH_KS8695
	select MII
	help
	  If you wish to compile a kernel for the KS8695 and want to
	  use the internal ethernet then you should answer Y to this.

config EP93XX_ETH
	tristate "EP93xx Ethernet support"
	depends on ARM && ARCH_EP93XX
	select MII
	help
	  This is a driver for the ethernet hardware included in EP93xx CPUs.
	  Say Y if you are building a kernel for EP93xx based devices.

config IXP4XX_ETH
	tristate "Intel IXP4xx Ethernet support"
	depends on ARM && ARCH_IXP4XX && IXP4XX_NPE && IXP4XX_QMGR
	select PHYLIB
	help
	  Say Y here if you want to use built-in Ethernet ports
	  on IXP4xx processor.

config W90P910_ETH
	tristate "Nuvoton w90p910 Ethernet support"
	depends on ARM && ARCH_W90X900
	select PHYLIB
	select MII
	help
	  Say Y here if you want to use built-in Ethernet ports
	  on w90p910 processor.

#>>Add at 2011/05/06 by yanjie_yang
config SNX_MAC
	tristate "SONiX Ethernet support"
	depends on NET_ETHERNET && ARM && ARCH_SN986XX
	select CRC32
	select MII
	help
	  This is a driver for the ethernet hardware included in SN986XX CPUs.
	  Say Y if you are building a kernel for SN986XX based devices.
#<<Add at 2011/05/06 by yanjie_yang
	  
config SNX_MAC_ZERO_COPY
	bool "Sonix MAC support zero-copy"
	depends on SNX_MAC
	default n
	help
		Say Y here if you want to enable zero-copy feature in Sonix MAC.
		This feature implement TX path only.
 
```
